## boards/shields/pw_semiflex/Kconfig.defconfig
```kconfig
if SHIELD_PW_SEMIFLEX_LEFT

config ZMK_KEYBOARD_NAME
    default "PW Semiflex"

config ZMK_SPLIT_ROLE_CENTRAL
    default y

endif

if SHIELD_PW_SEMIFLEX_LEFT || SHIELD_PW_SEMIFLEX_RIGHT

config ZMK_SPLIT
    default y

endif
```

## boards/shields/pw_semiflex/Kconfig.shield
```kconfig
config SHIELD_PW_SEMIFLEX_LEFT
    def_bool $(shields_list_contains,pw_semiflex_left)

config SHIELD_PW_SEMIFLEX_RIGHT
    def_bool $(shields_list_contains,pw_semiflex_right)
```
